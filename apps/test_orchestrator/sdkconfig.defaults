## apps/test_stg_man/sdkconfig.defaults
```kconfig
CONFIG_PARTITION_TABLE_CUSTOM=y
CONFIG_PARTITION_TABLE_CUSTOM_FILENAME="partitions_custom.csv"
CONFIG_PARTITION_TABLE_FILENAME="partitions_custom.csv"
CONFIG_ESPTOOLPY_FLASHSIZE_4MB=y
```

## components/nimble_ctrl/Kconfig.projbuild
```kconfig
menu "NimBLE Controller"

config NIMBLE_CTRL_USE_TEST_HOOKS
    bool "Use mock handler for testing"
    default n
    help
        Compile and expose test hooks for the NimBLE Controller component.

config NIMBLE_CTRL_MAX_GATT_DB_ENTRIES
    int "Max GATT DB entries"
    default 32
    help
        Maximum number of GATT DB entries that can be registered with the NimBLE Controller component. This is used to size internal data structures for managing GATT access callbacks and storage bindings.
endmenu
```

## components/orchestrator/Kconfig.projbuild
```kconfig
menu "Retrofit OS Orchestrator"

config ORCH_USE_MOCK_HANDLERS
    bool "Use mock handler for testing"
    default n
    help
        Use a mock handler instead of the real one for testing purposes.
endmenu
```
